## app/dts/bindings/behaviors/zmk,behavior-unibody-direct.yaml
```yaml
# Copyright (c) 2026 The ZMK Contributors
# SPDX-License-Identifier: MIT

description: Unibody Direct Binding Behavior

compatible: "zmk,behavior-unibody-direct"

include: zero_param.yaml
```

## app/dts/bindings/behaviors/zmk,behavior-unibody-dongle.yaml
```yaml
# Copyright (c) 2026 The ZMK Contributors
# SPDX-License-Identifier: MIT

description: Unibody Dongle Binding Behavior

compatible: "zmk,behavior-unibody-dongle"

include: zero_param.yaml
```

## app/dts/bindings/behaviors/zmk,behavior-unibody-toggle.yaml
```yaml
# Copyright (c) 2026 The ZMK Contributors
# SPDX-License-Identifier: MIT

description: Unibody Toggle Binding Behavior

compatible: "zmk,behavior-unibody-toggle"

include: zero_param.yaml
```
